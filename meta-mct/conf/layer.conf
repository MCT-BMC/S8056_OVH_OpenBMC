## meta-mct/conf/layer.conf
```bitbake
# We have a conf and classes directory, add to BBPATH
BBPATH .= ":${LAYERDIR}"

# We have recipes-* directories, add to BBFILES
BBFILES += "${LAYERDIR}/meta-common/recipes-*/*/*.bb \
            ${LAYERDIR}/meta-common/recipes-*/*/*.bbappend"

BBFILE_COLLECTIONS += "mct"
BBFILE_PATTERN_mct := "^${LAYERDIR}/"
LAYERVERSION_mct = "1"
LAYERSERIES_COMPAT_mct = "honister kirkstone"

# Provide a variable that points the base of the mct layer.
MCTBASE = '${@os.path.normpath("${LAYERDIR}/")}'
```

## meta-mct/conf/machine/include/mct.inc
```bitbake
MACHINE_FEATURES += "\
        obmc-phosphor-fan-mgmt \
        obmc-host-ipmi \
        "

VIRTUAL-RUNTIME_obmc-host-state-manager = "x86-power-control"
VIRTUAL-RUNTIME_obmc-chassis-state-manager = "x86-power-control"
VIRTUAL-RUNTIME_obmc-discover-system-state = "x86-power-control"
VIRTUAL-RUNTIME_obmc-inventory-manager = "entity-manager"

PREFERRED_PROVIDER_virtual/obmc-fan-mgmt = "packagegroup-mct-apps"
PREFERRED_PROVIDER_virtual/obmc-system-mgmt = "packagegroup-mct-apps"
PREFERRED_PROVIDER_virtual/obmc-host-ipmi-hw = "phosphor-ipmi-kcs"
PREFERRED_PROVIDER_virtual/obmc-gpio-monitor = "phosphor-gpio-monitor"
```

## meta-mct/meta-s7106/conf/layer.conf
```bitbake
# We have a conf and classes directory, add to BBPATH
BBPATH .= ":${LAYERDIR}"

# We have recipes-* directories, add to BBFILES
BBFILES += "${LAYERDIR}/recipes-*/*/*.bb \
            ${LAYERDIR}/recipes-*/*/*.bbappend"

BBFILE_COLLECTIONS += "s7106"
BBFILE_PATTERN_s7106 = ""
BBFILE_PRIORITY_s7106 = "5"
```

## meta-mct/meta-s7106/conf/machine/s7106.conf
```bitbake
KMACHINE = "aspeed"
KERNEL_DEVICETREE = "${KMACHINE}-bmc-mct-s7106.dtb"

require conf/machine/include/ast2500.inc
require conf/machine/include/obmc-bsp-common.inc
require conf/machine/include/mct.inc

UBOOT_MACHINE = "ast_g5_phy_config"

FLASH_SIZE = "32768"

VIRTUAL-RUNTIME_skeleton_workbook = "${MACHINE}-config"

PREFERRED_PROVIDER_virtual/phosphor-led-manager-config-native = "s7106-led-manager-config-native"
#PREFERRED_PROVIDER_virtual/phosphor-ipmi-sensor-inventory = "s7106-ipmi-sensor-map-native"

PREFERRED_PROVIDER_virtual/obmc-host-ctl = "packagegroup-mct-apps"
PREFERRED_PROVIDER_virtual/obmc-host-ipmi-hw = "phosphor-ipmi-kcs"
PREFERRED_PROVIDER_virtual/obmc-gpio-monitor = "phosphor-gpio-monitor"
PREFERRED_RPROVIDER_virtual/phosphor-ipmi-config = "s7106-ipmi-config"
```

## meta-mct/meta-s8033/conf/distro/s8033-pass.conf
```bitbake
EXTRA_USERS_PARAMS_pn-obmc-phosphor-image = " \
  usermod -p '$(openssl passwd -1 root)' root; \
  "
```

## meta-mct/meta-s8033/conf/layer.conf
```bitbake
# We have a conf and classes directory, add to BBPATH
BBPATH .= ":${LAYERDIR}"

# We have recipes-* directories, add to BBFILES
BBFILES += "${LAYERDIR}/recipes-*/*/*.bb \
            ${LAYERDIR}/recipes-*/*/*.bbappend"

BBFILE_COLLECTIONS += "s8033"
BBFILE_PATTERN_s8033 = "^${LAYERDIR}/"
BBFILE_PRIORITY_s8033 = "5"
LAYERSERIES_COMPAT_s8033 = "honister kirkstone"
```

## meta-mct/meta-s8033/conf/machine/s8033.conf
```bitbake
KMACHINE = "aspeed"
KERNEL_DEVICETREE = "${KMACHINE}-bmc-mct-s8033.dtb"

require conf/machine/include/ast2500.inc
require conf/machine/include/obmc-bsp-common.inc
require conf/machine/include/mct.inc

UBOOT_MACHINE = "ast_g5_phy_config"

FLASH_SIZE = "65536"
FLASH_KERNEL_OFFSET = "1024"
FLASH_ROFS_OFFSET = "10240"
FLASH_RWFS_OFFSET = "43008"

VIRTUAL-RUNTIME_obmc-host-state-manager = "x86-power-control"
VIRTUAL-RUNTIME_obmc-chassis-state-manager = "x86-power-control"
VIRTUAL-RUNTIME_obmc-discover-system-state = "x86-power-control"

PREFERRED_PROVIDER_virtual/obmc-host-ctl = "packagegroup-mct-apps"
PREFERRED_PROVIDER_virtual/obmc-host-ipmi-hw = "phosphor-ipmi-kcs"
PREFERRED_PROVIDER_virtual/obmc-gpio-monitor = "phosphor-gpio-monitor"
PREFERRED_PROVIDER_virtual/bootloader = "u-boot-aspeed"
PREFERRED_PROVIDER_u-boot-fw-utils = "u-boot-fw-utils-aspeed"
PREFERRED_PROVIDER_u-boot = "u-boot-aspeed"

DISTRO_FEATURES:remove = "avahi"
```

## meta-mct/meta-s8053/conf/layer.conf
```bitbake
# We have a conf and classes directory, add to BBPATH
BBPATH .= ":${LAYERDIR}"

# We have recipes-* directories, add to BBFILES
BBFILES += "${LAYERDIR}/recipes-*/*/*.bb \
            ${LAYERDIR}/recipes-*/*/*.bbappend"

BBFILE_COLLECTIONS += "s8053"
BBFILE_PATTERN_s8053 = "^${LAYERDIR}/"
BBFILE_PRIORITY_s8053 = "5"
LAYERSERIES_COMPAT_s8053 = "honister kirkstone"
```

## meta-mct/meta-s8053/conf/machine/s8053.conf
```bitbake
require conf/machine/include/ast2600.inc
require conf/machine/include/obmc-bsp-common.inc
require conf/machine/include/mct.inc

# Overwrite flash layout
FLASH_SIZE = "65536"
FLASH_UBOOT_SPL_SIZE = "64"
FLASH_UBOOT_OFFSET = "0"
FLASH_KERNEL_OFFSET = "1024"
FLASH_ROFS_OFFSET = "10240"

# U-Boot Build Settings
UBOOT_MACHINE = "ast2600_openbmc_spl_defconfig"
UBOOT_DEVICETREE = "ast2600-s8053"
SPL_BINARY = "spl/u-boot-spl.bin"
SOCSEC_SIGN_ENABLE = "0"

SERIAL_CONSOLES = "115200;ttyS4"

# Kernel Build Settings
KMACHINE = "aspeed"
KERNEL_DEVICETREE = "${KMACHINE}-bmc-mct-${MACHINE}.dtb"

EXTRA_USERS_PARAMS:pn-obmc-phosphor-image = " \
  usermod -p '$(openssl passwd -1 root)' root; \
  "

PREFERRED_PROVIDER_virtual/obmc-host-ctl = "packagegroup-mct-apps"
PREFERRED_RPROVIDER_virtual/phosphor-ipmi-config = "${MACHINE}-ipmi-config"

DISTRO_FEATURES:remove = "avahi"
```

## meta-mct/meta-s8056/conf/layer.conf
```bitbake
# We have a conf and classes directory, add to BBPATH
BBPATH .= ":${LAYERDIR}"

# We have recipes-* directories, add to BBFILES
BBFILES += "${LAYERDIR}/recipes-*/*/*.bb \
            ${LAYERDIR}/recipes-*/*/*.bbappend"

BBFILE_COLLECTIONS += "s8056"
BBFILE_PATTERN_s8056 = "^${LAYERDIR}/"
BBFILE_PRIORITY_s8056 = "5"
LAYERSERIES_COMPAT_s8056 = "honister kirkstone"
```

## meta-wiwynn/conf/layer.conf
```bitbake
# We have a conf and classes directory, add to BBPATH
BBPATH .= ":${LAYERDIR}"

# We have recipes-* directories, add to BBFILES
BBFILES += "${LAYERDIR}/meta-common/recipes-*/*/*.bb \
            ${LAYERDIR}/meta-common/recipes-*/*/*.bbappend"

BBFILE_COLLECTIONS += "wiwynn-layer"
BBFILE_PATTERN_wiwynn-layer := "^${LAYERDIR}/"

LAYERVERSION_wiwynn-layer = "1"
LAYERSERIES_COMPAT_wiwynn-layer = "hardknott honister"

# Provide a variable that points the base of the wiwynn layer.
WIWYNNBASE = '${@os.path.normpath("${LAYERDIR}/")}'
```

## meta-wiwynn/meta-sv300g3e/conf/layer.conf
```bitbake
# We have a conf and classes directory, add to BBPATH
BBPATH .= ":${LAYERDIR}"

# We have recipes-* directories, add to BBFILES
BBFILES += "${LAYERDIR}/recipes-*/*/*.bb \
            ${LAYERDIR}/recipes-*/*/*.bbappend"

BBFILE_COLLECTIONS += "sv300g3e"
BBFILE_PATTERN_sv300g3e := "^${LAYERDIR}/"
# BBFILE_PRIORITY_sv300g3e = "5"
LAYERSERIES_COMPAT_sv300g3e = "warrior zeus"
```

## meta-wiwynn/meta-sv300g3e/conf/machine/sv300g3e.conf
```bitbake
KMACHINE = "aspeed"
KERNEL_DEVICETREE = "${KMACHINE}-bmc-wiwynn-${MACHINE}.dtb"

require conf/machine/include/ast2500.inc
require conf/machine/include/obmc-bsp-common.inc
require conf/machine/include/wiwynn.inc

UBOOT_MACHINE = "ast_g5_phy_config"

# FLASH_SIZE = "32768"
FLASH_SIZE = "65536"
FLASH_RWFS_OFFSET = "49152"

VIRTUAL-RUNTIME_skeleton_workbook = "${MACHINE}-config"

PREFERRED_PROVIDER_virtual/phosphor-led-manager-config-native ?= "sv300g3e-led-manager-config-native"

# PREFERRED_PROVIDER_virtual/obmc-host-ctl ?= "obmc-op-control-host"
PREFERRED_PROVIDER_virtual/obmc-host-ctl = "packagegroup-wiwynn-apps"
PREFERRED_PROVIDER_virtual/obmc-host-ipmi-hw = "phosphor-ipmi-kcs"
PREFERRED_PROVIDER_virtual/obmc-gpio-monitor = "phosphor-gpio-monitor"
```

## meta-wiwynn/meta-sv305/conf/layer.conf
```bitbake
# We have a conf and classes directory, add to BBPATH
BBPATH .= ":${LAYERDIR}"

# We have recipes-* directories, add to BBFILES
BBFILES += "${LAYERDIR}/recipes-*/*/*.bb \
            ${LAYERDIR}/recipes-*/*/*.bbappend"

BBFILE_COLLECTIONS += "sv305"
BBFILE_PATTERN_sv305 := "^${LAYERDIR}/"
# BBFILE_PRIORITY_sv300g3e = "5"
LAYERSERIES_COMPAT_sv305 = "hardknott honister"
```

## meta-wiwynn/meta-sv305/conf/machine/sv305.conf
```bitbake
KMACHINE = "aspeed"
KERNEL_DEVICETREE = "${KMACHINE}-bmc-wiwynn-${MACHINE}.dtb"
KERNEL_FEATURES_remove = "phosphor-gpio-keys phosphor-vlan"

require conf/machine/include/ast2500.inc
require conf/machine/include/obmc-bsp-common.inc
require conf/machine/include/wiwynn.inc

UBOOT_MACHINE = "ast_g5_phy_config"

#FLASH_SIZE = "32768"
FLASH_SIZE = "65536"
FLASH_RWFS_OFFSET = "49152"

VIRTUAL-RUNTIME_skeleton_workbook = "${MACHINE}-config"

PREFERRED_PROVIDER_virtual/phosphor-led-manager-config-native ?= "sv305-led-manager-config-native"

PREFERRED_PROVIDER_virtual/obmc-host-ctl = "packagegroup-wiwynn-apps"
PREFERRED_PROVIDER_virtual/obmc-host-ipmi-hw = "phosphor-ipmi-kcs"
PREFERRED_PROVIDER_virtual/obmc-gpio-monitor = "phosphor-gpio-monitor"

DISTRO_FEATURES_remove += "avahi"
```

## meta-wiwynn/meta-sv310a/conf/layer.conf
```bitbake
# We have a conf and classes directory, add to BBPATH
BBPATH .= ":${LAYERDIR}"

# We have recipes-* directories, add to BBFILES
BBFILES += "${LAYERDIR}/recipes-*/*/*.bb \
            ${LAYERDIR}/recipes-*/*/*.bbappend"

BBFILE_COLLECTIONS += "sv310a"
BBFILE_PATTERN_sv310a := "^${LAYERDIR}/"
# BBFILE_PRIORITY_sv300g3e = "5"
LAYERSERIES_COMPAT_sv310a = "hardknott honister"
```
